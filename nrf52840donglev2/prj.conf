## CMakeLists.txt
```
cmake_minimum_required(VERSION 3.20.0)
find_package(Zephyr REQUIRED HINTS $ENV{ZEPHYR_BASE})
project(nrf52840donglev2)

target_sources(app PRIVATE src/main.c)

target_sources(app PRIVATE src/pihub_usb_hid.c)
```

## prj.conf
```kconfig
# PiHub: BLE HID + USB CDC ACM no logs (NCS 3.2.x)

CONFIG_MAIN_STACK_SIZE=2048
CONFIG_SYSTEM_WORKQUEUE_STACK_SIZE=2048
CONFIG_HEAP_MEM_POOL_SIZE=1024

# Logging / console
CONFIG_CONSOLE=n
CONFIG_PRINTK=n
CONFIG_LOG=n
CONFIG_LOG_DEFAULT_LEVEL=3

# Serial console over USB CDC ACM (legacy stack)
CONFIG_SERIAL=y
CONFIG_UART_CONSOLE=n
CONFIG_UART_INTERRUPT_DRIVEN=y
CONFIG_UART_LINE_CTRL=y

# --- USB (LEGACY device stack) ---
CONFIG_USB_DEVICE_STACK=y
CONFIG_USB_CDC_ACM=y
CONFIG_USB_DEVICE_INITIALIZE_AT_BOOT=y
CONFIG_USB_DEVICE_STACK_NEXT=n
CONFIG_LOG_BACKEND_UART=n
CONFIG_LOG_BACKEND_RTT=n
CONFIG_USE_SEGGER_RTT=n
CONFIG_DK_LIBRARY=y

# Bluetooth LE
CONFIG_BT=y
CONFIG_BT_PERIPHERAL=y
CONFIG_BT_SMP=y
CONFIG_BT_MAX_CONN=1

# GATT pool sizing to avoid runtime asserts
CONFIG_BT_GATT_UUID16_POOL_SIZE=40
CONFIG_BT_GATT_CHRC_POOL_SIZE=20
CONFIG_BT_ATT_TX_COUNT=5

CONFIG_BT_DEVICE_NAME="PiHub nrf Remote"
CONFIG_BT_DEVICE_APPEARANCE=961

# Preferred params (PPCP)
CONFIG_BT_GAP_PERIPHERAL_PREF_PARAMS=y
CONFIG_BT_PERIPHERAL_PREF_MIN_INT=12
CONFIG_BT_PERIPHERAL_PREF_MAX_INT=12
CONFIG_BT_PERIPHERAL_PREF_LATENCY=0
CONFIG_BT_PERIPHERAL_PREF_TIMEOUT=300

# Keep updates explicit (avoid some controllers colliding procedures)
CONFIG_BT_AUTO_PHY_UPDATE=n
CONFIG_BT_GATT_AUTO_SEC_REQ=n

# Data length / PHY support (optional)
CONFIG_BT_DATA_LEN_UPDATE=y
CONFIG_BT_PHY_UPDATE=y
CONFIG_BT_CTLR_PHY_2M=y

# Settings/bonding
CONFIG_BT_BONDABLE=y
CONFIG_BT_SETTINGS=y
CONFIG_SETTINGS=y
CONFIG_BT_SETTINGS_CCC_STORE_ON_WRITE=y

# Flash-backed settings
CONFIG_FLASH=y
CONFIG_FLASH_MAP=y
CONFIG_FLASH_PAGE_LAYOUT=y
CONFIG_NVS=y
CONFIG_SETTINGS_NVS=y
CONFIG_REBOOT=y
```

## src/pihub_usb_hid.c
```c
/*
 * PiHub USB HID link (legacy USB device stack).
 *
 * Vendor-defined HID interface used as a reliable transport between PiHub (host)
 * and the nRF52840 dongle (device).
 *
 * - OUT reports (host -> device) carry:
 *     - Binary hot path frames (0x01 + 8, 0x02 + 2)
 *     - ASCII commands (PING/STATUS/UNPAIR) newline-delimited
 * - IN reports (device -> host) carry ASCII lines (EVT/STATUS/OK/PONG/ERR...) newline-delimited
 *
 * This keeps the on-wire protocol identical to the earlier CDC ACM design, but
 * avoids tty/ACM re-enumeration issues.
 */

#include <zephyr/kernel.h>
#include <zephyr/device.h>
#include <zephyr/usb/usb_device.h>
#include <zephyr/usb/class/usb_hid.h>
#include <zephyr/usb/class/hid.h>
#include <string.h>

extern void pihub_cmd_rx_bytes(const uint8_t *p, size_t n);

static const struct device *hdev;

/* Simple vendor-defined IN/OUT reports, 64 bytes each, no Report ID. */
static const uint8_t hid_report_desc[] = {
    HID_USAGE_PAGE(0xFF),                /* Vendor-defined */
    HID_USAGE(0x01),
    HID_COLLECTION(HID_COLLECTION_APPLICATION),

    /* OUT report */
    HID_LOGICAL_MIN8(0x00),
    HID_LOGICAL_MAX16(0xFF, 0x00),
    HID_REPORT_SIZE(8),
    HID_REPORT_COUNT(64),
    HID_USAGE(0x01),
    HID_OUTPUT(0x02),                    /* Data,Var,Abs */

    /* IN report */
    HID_REPORT_SIZE(8),
    HID_REPORT_COUNT(64),
    HID_USAGE(0x01),
    HID_INPUT(0x02),                     /* Data,Var,Abs */

    HID_END_COLLECTION,
};

static void status_cb(enum usb_dc_status_code status, const uint8_t *param)
{
    ARG_UNUSED(param);
    switch (status) {
    case USB_DC_CONFIGURED:
        /* Host configured us; nothing else required. */
        break;
    default:
        break;
    }
}

static void int_in_ready_cb(const struct device *dev)
{
    ARG_UNUSED(dev);
}

static void int_out_ready_cb(const struct device *dev)
{
    uint8_t buf[64];
    uint32_t n = 0;

    if (hid_int_ep_read(dev, buf, sizeof(buf), &n) == 0 && n > 0) {
        pihub_cmd_rx_bytes(buf, (size_t)n);
    }
}

static const struct hid_ops ops = {
    .int_in_ready = int_in_ready_cb,
    .int_out_ready = int_out_ready_cb,
};

int pihub_usb_hid_init(void)
{
    hdev = device_get_binding("HID_0");
    if (!hdev) {
        return -ENODEV;
    }

    usb_hid_register_device(hdev, hid_report_desc, sizeof(hid_report_desc), &ops);

    int ret = usb_hid_init(hdev);
    if (ret) {
        return ret;
    }

    return usb_enable(status_cb);
}

int pihub_usb_hid_write(const uint8_t *data, size_t len)
{
    if (!hdev || !data || len == 0) {
        return -EINVAL;
    }

    uint8_t pkt[64];
    memset(pkt, 0, sizeof(pkt));
    if (len > sizeof(pkt)) {
        len = sizeof(pkt);
    }
    memcpy(pkt, data, len);

    return hid_int_ep_write(hdev, pkt, sizeof(pkt), NULL);
}
```

## src/pihub_usb_hid.h
```c
#pragma once
#include <stddef.h>
#include <stdint.h>

int pihub_usb_hid_init(void);
int pihub_usb_hid_write(const uint8_t *data, size_t len);
```
